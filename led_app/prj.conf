## CMakeLists.txt
```
cmake_minimum_required(VERSION 3.20.0)
list(APPEND DTS_ROOT ${CMAKE_CURRENT_SOURCE_DIR}/..)
#set(EXTRA_DTC_OVERLAY_FILE "${CMAKE_CURRENT_SOURCE_DIR}/led_app.overlay")
find_package(Zephyr REQUIRED HINTS $ENV{ZEPHYR_BASE})
project(led_app LANGUAGES C CXX)
target_sources(app PRIVATE src/main.cpp)
add_subdirectory(drivers/l6driver)
```

## Kconfig
```
source "Kconfig.zephyr"
rsource "drivers/l6driver/Kconfig"
```

## prj.conf
```kconfig
CONFIG_GPIO=y
CONFIG_SENSOR=y   
CONFIG_L6_DRIVER=y
CONFIG_LOG=y
CONFIG_CONSOLE=y
CONFIG_SHELL=y
CONFIG_SHELL_BACKEND_SERIAL=y #attaches the shell to whatever device is set as zephyr,console in your overlay — 
                            #so if you already have USB CDC-ACM as the console, the shell appears on that same COM port automatically.
CONFIG_USB_DEVICE_STACK=y
CONFIG_USB_CDC_ACM=y #turns the USB port into a virtual serial port without extra wires for UART. but its not actually UART.
CONFIG_USB_DEVICE_INITIALIZE_AT_BOOT=y
CONFIG_BOOT_DELAY=2000
```

## app.overlay
```dts
//This is the device tree node for a simple led driver
/ {
    led_driver0: led_driver{
        compatible = "my,l6driver";
        status = "okay"; // other value as "disabled"
        gpios = <&gpio0 6 GPIO_ACTIVE_LOW>; // blue led
    };
};

// / {
//     chosen {
//         zephyr,console = &cdc_acm_uart0;
//         zephyr,shell-uart = &cdc_acm_uart0;
//     };
// };

// &zephyr_udc0 {
//     cdc_acm_uart0: cdc_acm_uart0 {
//         compatible = "zephyr,cdc-acm-uart";
//     };
// };
```

## src/main.cpp
```c
//#---------------------------------Homework L7-task2---------------------------
#include <zephyr/drivers/gpio.h>
#include <zephyr/kernel.h>
#include <zephyr/logging/log.h>
#include <zephyr/device.h>
#include <zephyr/drivers/sensor.h>   
#include "l6driver.h"                // custom API: l6driver_set/get_blink_speed
LOG_MODULE_REGISTER(main, LOG_LEVEL_INF);

int main(void){
    const struct device* driver = DEVICE_DT_GET(DT_NODELABEL(led_driver0));
    if(!device_is_ready(driver)){
            LOG_ERR("LED driver not ready yet!\n");
            return 0;
        }
        k_msleep(500);
        LOG_INF("LED driver is now ready!!\n");

    struct sensor_value val = {0};

    // Set an initial blink speed via the custom API (overwrites the 500 ms default
    // stored in the driver's dynamic data struct)
    l6driver_set_blink_speed(driver, 200);

   // test();
    while (1) {
        // LED on — via sensor API (sample_fetch)
        sensor_sample_fetch(driver);
        k_msleep(l6driver_get_blink_speed(driver));   // sleep duration from dynamic struct

        // LED off — via sensor API (channel_get)
        sensor_channel_get(driver, SENSOR_CHAN_ALL, &val);
        k_msleep(l6driver_get_blink_speed(driver));   // same period for off time
        /*This part of the code to set the speed parameter from l6-task2 is modified to allow
        the user to set the rate from shell and the speed stays constant until again changed
        by the user.*/

        // Gradually slow the blink speed to show the parameter changing at runtime
        uint32_t speed = l6driver_get_blink_speed(driver);
        LOG_INF("Current blink period: %u ms", l6driver_get_blink_speed(driver));
        l6driver_set_blink_speed(driver, speed); //setting default value of 200ms
        }
    return 0;
}
```
