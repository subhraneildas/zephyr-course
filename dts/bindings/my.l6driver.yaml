## dts/bindings/my.l6driver.yaml
```yaml
description: LED driver GPIO implementation
compatible: "my,l6driver"
include: base.yaml
properties:
  gpios:
    type: phandle-array
    required: true
    description: GPIO-controlled LED
```

## hello_world/boards/my_board/Kconfig.defconfig
```kconfig
# Copyright (c) 2020 Jefferson Lee.
# SPDX-License-Identifier: Apache-2.0

if BOARD_MY_BOARD

	config REGULATOR
		default y if SENSOR

	#if BOOTLOADER_MCUBOOT
		#choice MCUBOOT_BOOTLOADER_MODE
		#	default MCUBOOT_BOOTLOADER_MODE_OVERWRITE_ONLY
		#endchoice
	#endif # BOOTLOADER_MCUBOOT	

endif # BOARD_MY_BOARD
```

## hello_world/boards/my_board/board.yml
```yaml
board:
  name: my_board
  full_name: My Board
  vendor: neil
  socs:
  - name: nrf52840
    variants:
    - name: 'sense'
```

## hello_world_scratch/boards/my_board_scratch/Kconfig.defconfig
```kconfig
# Copyright (c) 2020 Jefferson Lee.
# SPDX-License-Identifier: Apache-2.0
config BOARD_MY_BOARD_SCRATCH
	#select BOARD_EARLY_INIT_HOOK
	#select USB_DEVICE_STACK
	#select GPIO
	#select SERIAL
	#select UART_CONSOLE
	#select SERIAL_HAS_DRIVER
	#select CONSOLE	
	if BOARD_MY_BOARD_SCRATCH
		#config REGULATOR
		#	default y if SENSOR
	endif # BOARD_MY_BOARD_SCRATCH
```

## hello_world_scratch/boards/my_board_scratch/Kconfig.my_board_scratch
```kconfig
# Copyright (c) 2020 Jefferson Lee.
# SPDX-License-Identifier: Apache-2.0

config BOARD_MY_BOARD_SCRATCH
	select SOC_NRF52840_QIAA if BOARD_MY_BOARD_SCRATCH
	bool "My Board from scratch"
```

## hello_world_scratch/boards/my_board_scratch/board.yml
```yaml
board:
  name: my_board_scratch
  full_name: My Board from scratch
  vendor: neil
  socs:
  - name: nrf52840
    variants:
    - name: 'sense'
```

## led_app/drivers/l6driver/Kconfig
```kconfig
config L6_DRIVER
    bool "l6_driver"
    default y
    select GPIO
    help
      Enables LED driver 
```

## led_app/drivers/led_driver/Kconfig
```kconfig
config LED_DRIVER
    bool "led_driver"
    default y
    select GPIO
    help
      Enables LED driver 
```
